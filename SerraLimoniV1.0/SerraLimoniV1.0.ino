#include "LEDMatrix.h"
#include <Timer.h>
#include <Wire.h>
#include <Adafruit_MLX90614.h>


#define WIDTH   64
#define HEIGHT  16

const int pinRele = 13;

Timer t;

// LEDMatrix(a, b, c, d, oe, r1, stb, clk);
LEDMatrix matrix(4, 5, 6, 7, 8, 9, 10, 11);

Adafruit_MLX90614 mlx = Adafruit_MLX90614();


// Display Buffer 128 = 64 * 16 / 8
uint8_t displaybuf[WIDTH *HEIGHT / 8] = {
    0x01, 0x00, 0x00, 0x00, 0x00, 0x00, 0x00, 0x00, 0x01, 0x80, 0x00, 0x00, 0x00, 0x00, 0x00, 0x00,
    0x01, 0xFC, 0x00, 0x00, 0x00, 0x00, 0x00, 0x60, 0x01, 0xF8, 0x00, 0x00, 0x00, 0x00, 0x00, 0x60,
    0x01, 0xF0, 0x00, 0x00, 0x00, 0x00, 0x00, 0x60, 0x00, 0xE0, 0x07, 0x8F, 0xC7, 0xC7, 0xC7, 0xE0,
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    0x0B, 0xF8, 0x00, 0x0C, 0x00, 0x00, 0x00, 0x00, 0x07, 0xF8, 0x00, 0x00, 0x00, 0x00, 0x00, 0x00,
};
// 16 * 8 digital font
const uint8_t digitals[] = {
    0x00, 0x1C, 0x36, 0x63, 0x63, 0x63, 0x63, 0x63, 0x63, 0x63, 0x36, 0x1C, 0x00, 0x00, 0x00, 0x00, // 0
    0x00, 0x18, 0x78, 0x18, 0x18, 0x18, 0x18, 0x18, 0x18, 0x18, 0x18, 0x7E, 0x00, 0x00, 0x00, 0x00, // 1
    0x00, 0x3E, 0x63, 0x63, 0x63, 0x06, 0x06, 0x0C, 0x18, 0x30, 0x63, 0x7F, 0x00, 0x00, 0x00, 0x00, // 2
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    0x00, 0x1C, 0x14, 0x1C, 0x00, 0x00, 0x00, 0x00, 0x00, 0x00, 0x00, 0x00, 0x00, 0x00, 0x00, 0x00, //sgn

};
void readTemp(){ // callback function every tot time
 
  
  float temperature = mlx.readAmbientTempC();
  
  if( temperature < 4.0) {
    digitalWrite(pinRele, HIGH);
  } 
  else if( temperature > 6.0 ) {
    digitalWrite(pinRele, LOW);
  }


  
  uint8_t  temp[2];
  
  float2Bytes(temperature, &temp[0]);
   
  matrix.clear();
  
  /* first simbol in the led matrix is the minus sign */
  if( temperature < 0 ){
     drawDigital(32,0, 10); 
  }
  /* second simbol in the led matrix is the most significant number*/
  if( temp[0] != 0 ) {
  drawDigital(40,0, temp[0]);
  }
  /* third simbol in the led matrix is the less significant number*/
  drawDigital(48,0, temp[1]);
  /* forth simbol in the led matrix is the degree celsius simbol*/
  drawDigital(56,0, 11);
    
}

void drawDigital(uint16_t x, uint16_t y, uint8_t n)
{
    if ((n > 11) || (0 != (x % 8))) { // (x, y) top-left position, x should be multiple of 8
        
        return;
    }
    
    uint8_t *pDst = displaybuf + y * (WIDTH / 8) + x / 8;
    
    const uint8_t *pSrc = digitals + n * 16;
    
    for (uint8_t i = 0; i < 16; i++) {
        *pDst = *pSrc;
        pDst += WIDTH / 8;
        pSrc++;
    }
}



void float2Bytes(float val,uint8_t* temp_array){
 
/* temp_array[0] = ((uint8_t)(val*10))/100; //msb
 temp_array[1] = (((uint8_t)(val*10))%100)/10;
 temp_array[2] = (((uint8_t)(val*10))%100)%10;*/
 temp_array[0] = ((uint8_t)(val))/10; //msb
 temp_array[1] = ((uint8_t)(val))%10;
 
}

void setup()
{  //Serial.begin(9600);
   pinMode(pinRele, OUTPUT);
   digitalWrite(pinRele, LOW);
   mlx.begin();  
   matrix.begin(displaybuf, WIDTH, HEIGHT);
   t.every(60000, readTemp,(void*)0);
}

void loop()
{
   t.update();
   matrix.scan();
     
}
